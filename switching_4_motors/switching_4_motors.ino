// Generated by generateSwitchingTemplate.py with motors_template.ino as
// base code, both written by Skyler Williams.
// 
// Code for working with Blender Gesture Developer addon.
// 
#include <Servo.h>
// Servo definitions (line 2)
Servo myServo0;
Servo myServo1;
Servo myServo2;
Servo myServo3;
// Number of servos (line 3)
int numServos = 4;
// Servo pin definitions (line 4)
int servoPin0 = 13;
int servoPin1 = 7;
int servoPin2 = 2;
int servoPin3 = 4;
// Type is "byte" so we get an unsigned 8-bit value
int data;
int currentServo = 0;

void setup() {
  // Attaching servos (line 10)
  myServo0.attach(servoPin0);
  myServo1.attach(servoPin1);
  myServo2.attach(servoPin2);
  myServo3.attach(servoPin3);
  Serial.begin(9600);
}

void loop() {
  // If Serial data is available
  if(Serial.available()) {
    // Read serial data and write back for error check
    data = Serial.read();      
    Serial.write(data);
    // Bounds check data for the motors
    if (data < 0) {
        data = 0;
    } else if (data > 180) {
      // Data exceeds 180 (24)
      data = 180;
      // Else + switch for addressing scheme (25)
    } 
    switch (currentServo) {
      case 0:
        myServo0.write(data);
        break;
      case 1:
        myServo1.write(data);
        break;
      case 2:
        myServo2.write(data);
        break;
      case 3:
        myServo3.write(data);
        break;
    }
    // Switch on currentServo and write (27)
    ++currentServo;
    if (currentServo == numServos) {
        currentServo = 0;
    }    // Increment the currentServo, and reset if over bounds (28)
  }
}